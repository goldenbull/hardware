## amoled-clock/main/Kconfig.projbuild
```kconfig
menu "AMOLED Clock 配置"

    config APP_WIFI_SSID
        string "Wi-Fi SSID"
        default "your ssid"
        help
            要连接的 2.4GHz 无线网络名称。ESP32-S3 不支持 5GHz。

    config APP_WIFI_PASSWORD
        string "Wi-Fi 密码"
        default "your password"

    config APP_NTP_SERVER
        string "NTP 服务器"
        default "ntp.aliyun.com"
        help
            主服务器。连不上时会依次换 ntp.tencent.com、ntp.ntsc.ac.cn、
            cn.pool.ntp.org（备用列表在 net_time.c 里）。

    config APP_TIMEZONE
        string "时区（POSIX TZ 字符串）"
        default "CST-8"
        help
            北京时间为 CST-8。注意 POSIX 的符号是反的，东八区写 -8。

    config APP_TEMP_HOT_THRESHOLD
        int "火焰动画触发温度（摄氏度）"
        default 30

    config APP_TEMP_COLD_THRESHOLD
        int "雪花动画触发温度（摄氏度）"
        default 20

endmenu
```

## amoled-clock/sdkconfig.defaults
```kconfig
CONFIG_IDF_TARGET="esp32s3"

# 16MB Flash, QIO 80MHz —— 与官方出厂固件一致
CONFIG_ESPTOOLPY_FLASHMODE_QIO=y
CONFIG_ESPTOOLPY_FLASHFREQ_80M=y
CONFIG_ESPTOOLPY_FLASHSIZE_16MB=y
CONFIG_PARTITION_TABLE_CUSTOM=y
CONFIG_PARTITION_TABLE_CUSTOM_FILENAME="partitions.csv"

# 8MB 八线 PSRAM。两块全屏帧缓冲 + 两块动画画布都放在这里，
# 所以 SPIRAM_USE_MALLOC 必须开着。
CONFIG_SPIRAM=y
CONFIG_SPIRAM_MODE_OCT=y
CONFIG_SPIRAM_SPEED_80M=y
CONFIG_SPIRAM_USE_MALLOC=y
CONFIG_SPIRAM_FETCH_INSTRUCTIONS=y
CONFIG_SPIRAM_RODATA=y

CONFIG_ESP_DEFAULT_CPU_FREQ_MHZ_240=y
CONFIG_COMPILER_OPTIMIZATION_PERF=y
CONFIG_FREERTOS_HZ=1000
CONFIG_ESP_MAIN_TASK_STACK_SIZE=8192

# LVGL：esp_lcd 送出的是字节序交换过的 RGB565
CONFIG_LV_COLOR_16_SWAP=y
CONFIG_LV_MEM_CUSTOM=y
CONFIG_LV_MEMCPY_MEMSET_STD=y
CONFIG_LV_ATTRIBUTE_FAST_MEM_USE_IRAM=y
CONFIG_LV_USE_CANVAS=y
# 界面用的是 main/fonts/ 下自己生成的中文字模，内置字体只留 LVGL 的默认那一个
CONFIG_LV_FONT_MONTSERRAT_14=y
CONFIG_LV_USE_PERF_MONITOR=n
CONFIG_LV_USE_MEM_MONITOR=n
```

## lcd-clock/clock/main/Kconfig.projbuild
```kconfig
menu "LCD Clock 配置"

    config APP_WIFI_SSID
        string "Wi-Fi SSID"
        default "your ssid"
        help
            要连接的无线网络名称。ESP32-C5 支持 2.4GHz 和 5GHz。

    config APP_WIFI_PASSWORD
        string "Wi-Fi 密码"
        default "your password"

    config APP_NTP_SERVER
        string "NTP 服务器"
        default "ntp.aliyun.com"
        help
            主服务器。连不上时会依次换 ntp.tencent.com、ntp.ntsc.ac.cn、
            cn.pool.ntp.org（备用列表在 net_time.c 里）。

    config APP_TIMEZONE
        string "时区（POSIX TZ 字符串）"
        default "CST-8"
        help
            北京时间为 CST-8。注意 POSIX 的符号是反的，东八区写 -8。

    config APP_TEMP_HOT_THRESHOLD
        int "火焰动画触发温度（摄氏度）"
        default 30

    config APP_TEMP_COLD_THRESHOLD
        int "雪花动画触发温度（摄氏度）"
        default 20

    config APP_SHT4X_PWR_GPIO
        int "SHT45 供电 GPIO（-1 = 接 3V3 电源轨）"
        range -1 28
        default -1
        help
            SHT45 的 VDD 接到某个 GPIO 上时填这个 GPIO，开机时最先拉高。
            接板上 3V3 就保持 -1。

    config APP_BRIGHTNESS_DEFAULT
        int "开机背光亮度 (%)"
        range 5 100
        default 60

    config APP_IMU_AUTO_FLIP
        bool "根据 IMU 自动把屏幕翻转 180°"
        default y

    choice APP_IMU_UP_AXIS
        prompt "IMU 上哪个轴对着屏幕的上下方向"
        depends on APP_IMU_AUTO_FLIP
        default APP_IMU_UP_AXIS_Y
        help
            这块板子上是 Y 轴（amoled-clock 那块是 X 轴）。开机日志会打印三个轴的读数：把板子横着立起来，
            读数接近 ±1g 的那个轴就是。

        config APP_IMU_UP_AXIS_X
            bool "X"
        config APP_IMU_UP_AXIS_Y
            bool "Y"
    endchoice

    config APP_IMU_UP_INVERT
        bool "IMU 方向取反（屏幕立正了却显示倒的就勾上）"
        depends on APP_IMU_AUTO_FLIP
        default n

    config APP_VOICE_ENABLE
        bool "声控开关屏"
        default y
        help
            麦克风持续采集，按下面选的方式开关屏。

    choice APP_VOICE_MODE
        prompt "声控方式"
        depends on APP_VOICE_ENABLE
        default APP_VOICE_MODE_LEVEL

        config APP_VOICE_MODE_LEVEL
            bool "音量触发：听到够响的声音就切换开 / 关"
            help
                卧室很安静时最省事：拍一下手、清一下嗓子就切换。
                不区分说的是什么，所以只能"切换"，不能单独开或关。

        config APP_VOICE_MODE_KWS
            bool "关键词识别：打开屏幕 / 关闭屏幕（模型还没接上）"
    endchoice

    config APP_SOUND_TRIGGER_ENABLE
        bool "启用音量触发开关屏"
        depends on APP_VOICE_MODE_LEVEL
        default n
        help
            不勾时麦克风照样采集、照样算音量，调试面板"声控"一行照常显示读数，
            只是响声不会去开关屏。可以先不勾，看着调试面板把阈值调好再打开。

    config APP_SOUND_THRESHOLD_DB
        int "触发音量 (dBFS)"
        depends on APP_VOICE_MODE_LEVEL
        range -60 0
        default -45
        help
            平滑后的音量（均方根，满幅为 0dB）升过这个值就切换一次屏幕。
            调试面板"声控"一行显示最近 1 秒平滑音量的最大值，拿它来调：
            想要触发的声音比这个值高、平时的动静（翻身、空调）比这个值低就对了。
            默认 -45 是实测值：增益 30dB 时，1 米左右正常说话或拍手能稳定触发。
            说话的均方根一般比峰值低 10dB 左右，所以比调试面板上的"峰值"要小。

    config APP_SOUND_SMOOTH_MS
        int "音量平滑时间常数 (ms)"
        depends on APP_VOICE_MODE_LEVEL
        range 20 1000
        default 100
        help
            越大越不容易被短促的响动（碰一下桌子、一声咔哒）触发，但拍手这种
            很短的声音也要更响才够得着阈值。

    config APP_SOUND_COOLDOWN_MS
        int "两次开关屏的最小间隔 (ms)"
        depends on APP_VOICE_MODE_LEVEL
        range 500 10000
        default 2000
        help
            从上一次开关屏（声控或者单击都算）完成起，这么久之内的声音不理会。

endmenu
```

## lcd-clock/clock/sdkconfig.defaults
```kconfig
CONFIG_IDF_TARGET="esp32c5"

# 32MB Flash，DIO 80MHz —— 与官方示例一致
CONFIG_ESPTOOLPY_FLASHMODE_DIO=y
CONFIG_ESPTOOLPY_FLASHFREQ_80M=y
CONFIG_ESPTOOLPY_FLASHSIZE_32MB=y
CONFIG_PARTITION_TABLE_CUSTOM=y
CONFIG_PARTITION_TABLE_CUSTOM_FILENAME="partitions.csv"

# 8MB 四线 PSRAM。动画画布放在这里，以后语音识别模型和特征缓冲也放这里
CONFIG_SPIRAM=y
CONFIG_SPIRAM_MODE_QUAD=y
CONFIG_SPIRAM_SPEED_80M=y
CONFIG_SPIRAM_USE_MALLOC=y

CONFIG_ESP_DEFAULT_CPU_FREQ_MHZ_240=y
CONFIG_COMPILER_OPTIMIZATION_PERF=y
CONFIG_FREERTOS_HZ=1000
CONFIG_ESP_MAIN_TASK_STACK_SIZE=8192

# LVGL：esp_lcd 送出的是字节序交换过的 RGB565
CONFIG_LV_COLOR_16_SWAP=y
CONFIG_LV_MEM_CUSTOM=y
CONFIG_LV_MEMCPY_MEMSET_STD=y
CONFIG_LV_USE_CANVAS=y
# 界面用的是 main/fonts/ 下自己生成的字模，内置字体只留 LVGL 的默认那一个
CONFIG_LV_FONT_MONTSERRAT_14=y
CONFIG_LV_USE_PERF_MONITOR=n

# NTP：主服务器 + 3 台备用，一台超时 lwIP 会自动换下一台。
# 去掉开机随机延时（最长 5 秒），拿到 IP 立刻发请求。
CONFIG_LWIP_SNTP_MAX_SERVERS=4
CONFIG_LWIP_SNTP_STARTUP_DELAY=n
```

## lcd-clock/components/mic/Kconfig
```kconfig
menu "麦克风"

    config KWS_MIC_GAIN_DB
        int "麦克风 PGA 增益 (dB)"
        range 0 42
        default 30
        help
            ES8311 模拟前级增益，只有 0/6/12/18/24/30/36/42 八档，其他值向下取整到最近一档。
            官方出厂固件录音用的是 30dB。

            调法：正常距离（30~50cm）正常音量说话时，界面电平条峰值落在 -20 ~ -6 dB 最好；
            大声说话时电平条变红、"削顶"计数在涨，就降一档。

            注意：一旦开始正式采集就不要再改。识别固件必须用同一个增益，
            否则模型在板子上听到的音量和训练时不一样。每次录音的增益都记在
            sessions.csv 里（kws-recorder）。

endmenu
```

## lcd-clock/kws-recorder/main/Kconfig.projbuild
```kconfig
menu "录音存储"

    choice REC_STORAGE
        prompt "录音存到哪里"
        default REC_STORAGE_HTTP
        help
            TF 卡：直接写到卡上的 /sdcard/kws/。
            HTTP 上传：边录边传到电脑上跑的 tools/upload_server.py，不需要 TF 卡。
            两种方式落下来的文件名、WAV 格式、sessions.csv 完全一样。

        config REC_STORAGE_SD
            bool "TF 卡"

        config REC_STORAGE_HTTP
            bool "HTTP 上传到电脑"
    endchoice

    config REC_WIFI_SSID
        string "Wi-Fi SSID"
        depends on REC_STORAGE_HTTP
        default "your ssid"

    config REC_WIFI_PASSWORD
        string "Wi-Fi 密码"
        depends on REC_STORAGE_HTTP
        default "your password"

    config REC_UPLOAD_URL
        string "上传服务器地址"
        depends on REC_STORAGE_HTTP
        default "http://192.168.1.100:8000"
        help
            电脑上运行 python3 tools/upload_server.py，启动时会打印要填的地址。
            电脑和板子必须在同一个局域网里。

endmenu
```

## lcd-clock/kws-recorder/sdkconfig.defaults
```kconfig
CONFIG_IDF_TARGET="esp32c5"

# 32MB Flash，DIO 80MHz —— 与官方示例一致
CONFIG_ESPTOOLPY_FLASHMODE_DIO=y
CONFIG_ESPTOOLPY_FLASHFREQ_80M=y
CONFIG_ESPTOOLPY_FLASHSIZE_32MB=y
CONFIG_PARTITION_TABLE_CUSTOM=y
CONFIG_PARTITION_TABLE_CUSTOM_FILENAME="partitions.csv"

# 8MB 四线 PSRAM。录音的 4MB 环形缓冲放在这里
CONFIG_SPIRAM=y
CONFIG_SPIRAM_MODE_QUAD=y
CONFIG_SPIRAM_SPEED_80M=y
CONFIG_SPIRAM_USE_MALLOC=y

CONFIG_ESP_DEFAULT_CPU_FREQ_MHZ_240=y
CONFIG_COMPILER_OPTIMIZATION_PERF=y
CONFIG_FREERTOS_HZ=1000
CONFIG_ESP_MAIN_TASK_STACK_SIZE=8192

# 录音文件名 open_001.wav 超出 8.3，要开长文件名
CONFIG_FATFS_LFN_HEAP=y
CONFIG_FATFS_MAX_LFN=255

# LVGL：esp_lcd 送出的是字节序交换过的 RGB565
CONFIG_LV_COLOR_16_SWAP=y
CONFIG_LV_MEM_CUSTOM=y
CONFIG_LV_MEMCPY_MEMSET_STD=y
# 界面用的是 main/fonts/ 下自己生成的中文字模，内置字体只留 LVGL 的默认那一个
CONFIG_LV_FONT_MONTSERRAT_14=y
CONFIG_LV_USE_PERF_MONITOR=n
```

## lcd-clock/sensor-test/sdkconfig.defaults
```kconfig
CONFIG_IDF_TARGET="esp32c5"

# 和 kws-recorder 一致：32MB Flash，DIO 80MHz
CONFIG_ESPTOOLPY_FLASHMODE_DIO=y
CONFIG_ESPTOOLPY_FLASHFREQ_80M=y
CONFIG_ESPTOOLPY_FLASHSIZE_32MB=y

# CPU 频率和正式固件一样，板子发热的条件才可比
CONFIG_ESP_DEFAULT_CPU_FREQ_MHZ_240=y
CONFIG_FREERTOS_HZ=1000
```

## lcd-clock/shtc3-test/main/Kconfig.projbuild
```kconfig
menu "SHTC3 测试配置"

    config SHTC3_TEST_BACKLIGHT
        int "背光亮度 (%)"
        range 0 100
        default 0
        help
            默认 0：屏不亮，排除背光发热。改成 80（正式固件的亮度）再跑一次，
            对比 SHTC3 读数升高多少，就知道背光对它的影响。

    config SHTC3_TEST_INTERVAL_MS
        int "测量间隔 (ms)"
        range 500 60000
        default 2000

endmenu
```

## m5stack/sdkconfig.defaults
```kconfig
CONFIG_ARDUINO_AUTOSTART=n
CONFIG_FREERTOS_HZ=1000
CONFIG_LIBC_NEWLIB=y
CONFIG_TOUCH_SUPPRESS_DEPRECATE_WARN=y
CONFIG_MBEDTLS_PSK_MODES=y
CONFIG_MBEDTLS_KEY_EXCHANGE_PSK=y
CONFIG_ESP_MAIN_TASK_STACK_SIZE=8192
CONFIG_ESPTOOLPY_FLASHSIZE_16MB=y
CONFIG_PARTITION_TABLE_CUSTOM=y
CONFIG_PARTITION_TABLE_CUSTOM_FILENAME="partitions.csv"
CONFIG_COMPILER_CXX_EXCEPTIONS=y
```
